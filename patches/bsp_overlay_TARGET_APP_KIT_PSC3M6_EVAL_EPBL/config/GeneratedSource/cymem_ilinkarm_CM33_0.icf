// This file is automatically generated.
define exported symbol CYMEM_CM33_0_m33_nvm_START = 0x2201B000;
define exported symbol CYMEM_CM33_0_m33_nvm_C_START = 0x0201B000;
define exported symbol CYMEM_CM33_0_m33_nvm_SIZE = 0x00019000;
define exported symbol CYMEM_CM33_0_m33_nvm_OFFSET = 0x0001B000;
define exported symbol CYMEM_CM33_0_m33_nvm_sel_START = CYMEM_CM33_0_m33_nvm_C_START;
define exported symbol CYMEM_CM33_0_m33ns_nvm_START = 0x22034000;
define exported symbol CYMEM_CM33_0_m33ns_nvm_C_START = 0x02034000;
define exported symbol CYMEM_CM33_0_m33ns_nvm_SIZE = 0x00014000;
define exported symbol CYMEM_CM33_0_m33ns_nvm_OFFSET = 0x00034000;
define exported symbol CYMEM_CM33_0_m33ns_nvm_sel_START = CYMEM_CM33_0_m33ns_nvm_C_START;
define exported symbol CYMEM_CM33_0_pas_START = 0x22048000;
define exported symbol CYMEM_CM33_0_pas_C_START = 0x02048000;
define exported symbol CYMEM_CM33_0_pas_SIZE = 0x00006000;
define exported symbol CYMEM_CM33_0_pas_OFFSET = 0x00048000;
define exported symbol CYMEM_CM33_0_pas_sel_START = CYMEM_CM33_0_pas_C_START;
define exported symbol CYMEM_CM33_0_m33_data_START = 0x24000000;
define exported symbol CYMEM_CM33_0_m33_data_C_START = 0x04000000;
define exported symbol CYMEM_CM33_0_m33_data_SIZE = 0x0000E800;
define exported symbol CYMEM_CM33_0_m33_data_OFFSET = 0x00000000;
define exported symbol CYMEM_CM33_0_m33_data_sel_START = CYMEM_CM33_0_m33_data_C_START;
define exported symbol CYMEM_CM33_0_m33ns_data_START = 0x2400E800;
define exported symbol CYMEM_CM33_0_m33ns_data_C_START = 0x0400E800;
define exported symbol CYMEM_CM33_0_m33ns_data_SIZE = 0x00011000;
define exported symbol CYMEM_CM33_0_m33ns_data_OFFSET = 0x0000E800;
define exported symbol CYMEM_CM33_0_m33ns_data_sel_START = CYMEM_CM33_0_m33ns_data_C_START;
define exported symbol CYMEM_CM33_0_m33ns_shm_data_START = 0x2401F800;
define exported symbol CYMEM_CM33_0_m33ns_shm_data_C_START = 0x0401F800;
define exported symbol CYMEM_CM33_0_m33ns_shm_data_SIZE = 0x00000800;
define exported symbol CYMEM_CM33_0_m33ns_shm_data_OFFSET = 0x0001F800;
define exported symbol CYMEM_CM33_0_m33ns_shm_data_sel_START = CYMEM_CM33_0_m33ns_shm_data_C_START;
